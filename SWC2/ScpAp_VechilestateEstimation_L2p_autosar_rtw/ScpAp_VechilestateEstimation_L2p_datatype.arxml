AUTOSAR XML (schema 00049)
standard types defined: float64
package /AUTOSAR_Platform/ImplementationDataTypes
  impl type float64_const: category=VALUE, base-type=float64, range raw -INF..INF, additional-native-type-qualifier=const
package /AUTOSAR_Platform/ImplementationDataTypes/SwAddrMethods
  sw addr method ASW_Variable: memory-allocation-keyword-policy=ADDR-METHOD-SHORT-NAME, section-initialization-policy=INIT, section-type=VAR
  sw addr method CODE: memory-allocation-keyword-policy=ADDR-METHOD-SHORT-NAME, section-type=CODE
  sw addr method CALIB: memory-allocation-keyword-policy=ADDR-METHOD-SHORT-NAME, section-type=CALIBRATION-VARIABLES
package /AUTOSAR_Platform/ImplementationDataTypes/Units
  unit NoUnit: factor-si-to-unit=1, offset-si-to-unit=0
