AUTOSAR XML (schema 00052)
package /PortInterfaces
  sender receiver interface RP_ScpAp_MotorSpeed_L1p_IF_MotorSpeed_L1p
    data RP_ScpAp_MotorSpeed_L1p_IF_MotorSpeed_L1p: category=VALUE, sw-calibration-access=READ-ONLY, type=uint8
