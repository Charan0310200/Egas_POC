AUTOSAR XML (schema 00049)
package /ComponentTypes
  swc implementation ScpAp_VechilestateEstimation_L2p_imp: programming-language=C, sw-version=1.17.1, used-code-generator=Embedded Coder 25.2 (R2025b) 28-Jul-2025, vendor-id=0, behavior=ScpAp_VechilestateEstimation_L2p_InternalBehavior
    code-descriptors:
      code Code
        artifact-descriptors:
          short-label=ScpAp_VechilestateEstimation_L2p_c, category=SWSRC
          short-label=ScpAp_VechilestateEstimation_L2p_data_c, category=SWSRC
          short-label=ScpAp_VechilestateEstimation_L2p_h, category=SWHDR
          short-label=ScpAp_VechilestateEstimation_L2p_private_h, category=SWHDR
          short-label=ScpAp_VechilestateEstimation_L2p_types_h, category=SWHDR
    resource consumption RsrcCons_ScpAp_VechilestateEstimation_L2p_New
      memory section CODE: sw-addrmethod=CODE
      memory section ASW_Variable: sw-addrmethod=ASW_Variable
      memory section CALIB: sw-addrmethod=CALIB
