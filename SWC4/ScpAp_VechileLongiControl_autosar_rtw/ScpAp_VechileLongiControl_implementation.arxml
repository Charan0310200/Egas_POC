AUTOSAR XML (schema 00049)
package /ComponentTypes
  swc implementation ScpAp_VechileLongiControl_imp: programming-language=C, sw-version=1.45.1, used-code-generator=Embedded Coder 25.2 (R2025b) 28-Jul-2025, vendor-id=0, behavior=ScpAp_VechileLongiControl_InternalBehavior
    code-descriptors:
      code Code
        artifact-descriptors:
          short-label=ScpAp_VechileLongiControl_c, category=SWSRC
          short-label=ScpAp_VechileLongiControl_h, category=SWHDR
          short-label=ScpAp_VechileLongiControl_private_h, category=SWHDR
          short-label=ScpAp_VechileLongiControl_types_h, category=SWHDR
    resource consumption RsrcCons_ScpAp_VechileLongiControl
      memory section CODE: sw-addrmethod=CODE
      memory section ASW_Variables: sw-addrmethod=ASW_Variables
