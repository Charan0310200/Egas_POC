AUTOSAR XML (schema 00049)
standard types defined: float64
package /AUTOSAR_Platform/DataConstrs
  range DC_SafetyMode_L2p_IDT: raw 0..255
  range DC_float64: raw -INF..INF
package /AUTOSAR_Platform/ImplementationDataTypes/SwAddrMethods
  sw addr method CODE: memory-allocation-keyword-policy=ADDR-METHOD-SHORT-NAME, section-type=CODE
  sw addr method CALIB: memory-allocation-keyword-policy=ADDR-METHOD-SHORT-NAME, section-type=CALIBRATION-VARIABLES
  sw addr method ASW_Variables: memory-allocation-keyword-policy=ADDR-METHOD-SHORT-NAME, section-initialization-policy=INIT, section-type=VAR
package /AUTOSAR_Platform/ImplementationDataTypes/Units
  unit NoUnit: factor-si-to-unit=1, offset-si-to-unit=0
