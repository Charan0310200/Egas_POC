AUTOSAR XML (schema 00049)
package /AUTOSAR_Platform/ImplementationDataTypes/SwAddrMethods
  sw addr method CALIB: memory-allocation-keyword-policy=ADDR-METHOD-SHORT-NAME, section-type=CALIBRATION-VARIABLES
