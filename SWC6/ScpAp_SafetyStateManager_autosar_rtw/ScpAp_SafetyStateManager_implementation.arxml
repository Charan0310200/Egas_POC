AUTOSAR XML (schema 00049)
package /ComponentTypes
  swc implementation ScpAp_SafetyStateManager_imp: programming-language=C, sw-version=1.148.1, used-code-generator=Embedded Coder 25.2 (R2025b) 28-Jul-2025, vendor-id=0, behavior=ScpAp_SafetyStateManager_InternalBehavior
    code-descriptors:
      code Code
        artifact-descriptors:
          short-label=ScpAp_SafetyStateManager_c, category=SWSRC
          short-label=ScpAp_SafetyStateManager_h, category=SWHDR
          short-label=ScpAp_SafetyStateManager_private_h, category=SWHDR
          short-label=ScpAp_SafetyStateManager_types_h, category=SWHDR
    resource consumption RsrcCons_ScpAp_SafetyStateManager
      memory section CODE: sw-addrmethod=CODE
      memory section ASW_Variables: sw-addrmethod=ASW_Variables
