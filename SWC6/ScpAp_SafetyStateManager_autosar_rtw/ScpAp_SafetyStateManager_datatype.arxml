AUTOSAR XML (schema 00049)
package /AUTOSAR_Platform/DataConstrs
  range DC_SafetyMode_L2p_IDT: raw 0..255
  range DC_VechSafetyStatus_L2p_IDT: raw 0..255
package /DataTypes/SwAddrMethods
  sw addr method ASW_Variables: memory-allocation-keyword-policy=ADDR-METHOD-SHORT-NAME, section-initialization-policy=INIT, section-type=VAR
  sw addr method CODE: memory-allocation-keyword-policy=ADDR-METHOD-SHORT-NAME, section-type=CODE
  sw addr method CALIB: memory-allocation-keyword-policy=ADDR-METHOD-SHORT-NAME, section-type=CALIBRATION-VARIABLES
package /DataTypes/Units
  unit NoUnit: factor-si-to-unit=1, offset-si-to-unit=0
