AUTOSAR XML (schema 00049)
package /ComponentTypes
  swc implementation ScpAp_SafetyModeManager_imp: programming-language=C, sw-version=1.28.1, used-code-generator=Embedded Coder 25.2 (R2025b) 28-Jul-2025, vendor-id=0, behavior=ScpAp_SafetyModeManager_InternalBehavior
    code-descriptors:
      code Code
        artifact-descriptors:
          short-label=ScpAp_SafetyModeManager_c, category=SWSRC
          short-label=ScpAp_SafetyModeManager_data_c, category=SWSRC
          short-label=ScpAp_SafetyModeManager_h, category=SWHDR
          short-label=ScpAp_SafetyModeManager_private_h, category=SWHDR
          short-label=ScpAp_SafetyModeManager_types_h, category=SWHDR
    resource consumption RsrcCons_ScpAp_SafetyModeManager
      memory section CODE: sw-addrmethod=CODE
      memory section AswVariable: sw-addrmethod=AswVariable
