AUTOSAR XML (schema 00049)
package /AUTOSAR_Platform/DataConstrs
  range DC_VechSafetyStatus_L2p_IDT: raw -INF..INF
  range DC_SafetyMode_L2p_IDT: raw 0..255
package /DataTypes/SwAddrMethods
  sw addr method CODE: memory-allocation-keyword-policy=ADDR-METHOD-SHORT-NAME, section-type=CODE
  sw addr method CALIB: memory-allocation-keyword-policy=ADDR-METHOD-SHORT-NAME, section-type=CONST
  sw addr method AswVariable: memory-allocation-keyword-policy=ADDR-METHOD-SHORT-NAME, section-initialization-policy=INIT, section-type=VAR
package /DataTypes/Units
  unit NoUnit: factor-si-to-unit=1, offset-si-to-unit=0
