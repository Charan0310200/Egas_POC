AUTOSAR XML (schema 00049)
package /ComponentTypes
  swc implementation ScpAp_SpeedSupervision_imp: programming-language=C, sw-version=1.104.1, used-code-generator=Embedded Coder 25.2 (R2025b) 28-Jul-2025, vendor-id=0, behavior=ScpAp_SpeedSupervision_InternalBehavior
    code-descriptors:
      code Code
        artifact-descriptors:
          short-label=ScpAp_SpeedSupervision_c, category=SWSRC
          short-label=ScpAp_SpeedSupervision_data_c, category=SWSRC
          short-label=ScpAp_SpeedSupervision_h, category=SWHDR
          short-label=ScpAp_SpeedSupervision_private_h, category=SWHDR
          short-label=ScpAp_SpeedSupervision_types_h, category=SWHDR
    resource consumption RsrcCons_ScpAp_SpeedSupervision
      memory section CODE: sw-addrmethod=CODE
      memory section ASW_Variables: sw-addrmethod=ASW_Variables
      memory section CALIB: sw-addrmethod=CALIB
