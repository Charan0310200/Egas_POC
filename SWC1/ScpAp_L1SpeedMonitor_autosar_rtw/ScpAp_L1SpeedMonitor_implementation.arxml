AUTOSAR XML (schema 00052)
package /ComponentTypes
  swc implementation ScpAp_L1SpeedMonitor_Implementation: programming-language=C, sw-version=1.158.1, used-code-generator=Embedded Coder 25.2 (R2025b) 28-Jul-2025, vendor-id=0, behavior=ScpAp_L1SpeedMonitor_InternalBehavior
    code-descriptors:
      code Code
        artifact-descriptors:
          short-label=ScpAp_L1SpeedMonitor_c, category=SWSRC
          short-label=ScpAp_L1SpeedMonitor_data_c, category=SWSRC
          short-label=ScpAp_L1SpeedMonitor_h, category=SWHDR
          short-label=ScpAp_L1SpeedMonitor_private_h, category=SWHDR
          short-label=ScpAp_L1SpeedMonitor_types_h, category=SWHDR
    resource consumption RsrcCons_ScpAp_L1SpeedMonitor
      memory section CODE: sw-addrmethod=CODE
      memory section AswVariable: sw-addrmethod=AswVariable
      memory section CALIB: sw-addrmethod=CALIB
